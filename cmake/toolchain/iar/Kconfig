## cmake/toolchain/iar/Kconfig
```kconfig
# SPDX-License-Identifier: Apache-2.0

config LD_LINKER_SCRIPT_SUPPORTED
	bool
	default n

choice LINKER_SCRIPT
	default CMAKE_LINKER_GENERATOR
endchoice

config TOOLCHAIN_IAR_SUPPORTS_USERSPACE
	def_bool n
	select TOOLCHAIN_SUPPORTS_USERSPACE

config TOOLCHAIN_IAR_SUPPORTS_THREAD_LOCAL_STORAGE
	def_bool y
	select TOOLCHAIN_SUPPORTS_THREAD_LOCAL_STORAGE

config COMMON_LIBC_ASCTIME_R
       bool
       default y

config COMMON_LIBC_CTIME_R
       bool
       default y

config COMMON_LIBC_GMTIME_R
       bool
       default y

config COMMON_LIBC_LOCALTIME_R_UTC
       bool
       default y

menu "IAR library options"

config IAR_SEMIHOSTING
	bool "Use the IAR semihosting implementation."
	depends on IAR_LIBC
	default n
	help
	  Use the semihosting implementation in the IAR library
	  instead of the Zephyr implementation.

config IAR_BUFFERED_WRITE
	bool "Use buffered write"
        depends on IAR_SEMIHOSTING
	default n
	help
	  Instead of printing one character at a time
	  this option uses a buffer to print a line
	  at a time instead, increasing speed of printout.

endmenu
```

## cmake/toolchain/iccarm/Kconfig
```kconfig
# Copyright (c) 2024 IAR Systems AB
# SPDX-License-Identifier: Apache-2.0

config LD_LINKER_SCRIPT_SUPPORTED
	bool
	default n

choice LINKER_SCRIPT
	default CMAKE_LINKER_GENERATOR
endchoice

config STACK_CANARIES
	bool
	default n


menu "IAR library options"

config IAR_SEMIHOSTING
	bool "Use the IAR semihosting implementation."
	depends on ICCARM_LIBC
	default n
	help
	  Use the semihosting implementation in the IAR library
	  instead of the Zephyr implementation.

config IAR_BUFFERED_WRITE
	bool "Use buffered write"
        depends on IAR_SEMIHOSTING
	default n
	help
	  Instead of printing one character at a time
	  this option uses a buffer to print a line
	  at a time instead, increasing speed of printout.

endmenu
```

## cmake/toolchain/iccarm/Kconfig.defconfig
```kconfig
# Copyright (c) 2024 IAR Systems AB
# SPDX-License-Identifier: Apache-2.0


config MISRA_SANE
  bool
  default y

config PICOLIBC_SUPPORTED
  bool
  default n

config TOOLCHAIN_HAS_BUILTIN_FFS
  bool
  default n

config FP16
  bool
  default y

# ICCARM does not support relaxation
config LINKER_USE_NO_RELAX
  bool
  default y

# ICCARM support C17 with some additional features from C23
config REQUIRES_STD_C17
	bool 
	default y
```
